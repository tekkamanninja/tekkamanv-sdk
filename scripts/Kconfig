## scripts/Kconfig
```kconfig
mainmenu "Tekkaman SDK main configuration[tekka-setup]"

source "scripts/boards/Kconfig"
```

## scripts/boards/Kconfig
```kconfig
menu "Development board vendors selection"

choice VENDOR_SELECTION
	bool "Development board vendors selection"
	default SOPHGO

	config SOPHGO
		bool "Sophgo"

	config THEAD
		bool "T-Head"

	config BEAGLEBOARD
		bool "Beagle Board"

	config SIPEED
		bool "Sipeed"

	config MILKV
		bool "Milk-V"

	config PINE64
		bool "PINE64"

	config STARFIVE
		bool "StarFive"

endchoice

choice BOARD_SELECTION
	bool "Development boards selection"
	default SG2042_EVB  if SOPHGO
	default TH1520_LIGHT if THEAD
	default BEAGLEV_AHEAD if BEAGLEBOARD
	default LICHEE_PI_4A if SIPEED
	default MILKV_PIONEER if MILKV
	default STAR64 if PINE64
	default VISIONFIVE_V2 if STARFIVE

	config SG2042_EVB
		depends on SOPHGO
		bool "Sophgo SG2042 EVB (SG2042)"

	config TH1520_LIGHT
		depends on THEAD
		bool "T-HEAD TH1520 LIGHT EVB"

	config BEAGLEV_AHEAD
		depends on BEAGLEBOARD
		bool "Beagle Board Ahead based on TH1520"

	config LICHEE_PI_4A
		depends on SIPEED
		bool "Lichee Pi 4A Ahead based on TH1520"

	config MILKV_PIONEER
		depends on MILKV
		bool "Milk-V Pioneer board based on Sophgo SG2042"

	config MILKV_DUO
		depends on MILKV
		bool "Milk-V Duo board based on Sophgo CV1800B"

	config STAR64
		depends on PINE64
		bool "Star64 board based on StarFive JH7110"

	config PINEBOOK_V
		depends on PINE64
		bool "Pinebook-V laptop based on StarFive JH7110"

	config VISIONFIVE_V2
		depends on STARFIVE
		bool "VisionFive V2 board based on StarFive JH7110"
endchoice

source "scripts/boards/*/Kconfig"

endmenu
```

## scripts/boards/Kconfig.image
```kconfig
menu "SD/flash Image deploy configuration"

config EFI_PATH
	string "the mount point of the EFI partition of SD card."
	default "/run/media/tekkamanninja/188A-2D18"

config BOOT_PATH
	string "the mount point of the BOOT partition of SD card."
	default "/run/media/tekkamanninja/__boot"

config ROOT_PATH
	string "the mount point of the ROOT partition of SD card."
	default "/run/media/tekkamanninja/__"

endmenu
```

## scripts/boards/beagleboard/Kconfig
```kconfig
if BEAGLEBOARD
	config VENDOR_NAME
		string
		default "beagleboard"

	config BOARD_NAME
		string
		default "beaglev_ahead" if BEAGLEV_AHEAD

	config ARCH
		string
		default "riscv" if BEAGLEV_AHEAD

	config TARGET_ARCH
		string
		default "riscv64" if BEAGLEV_AHEAD

	config CONFIG_FILE
		string "config file name for target board"
		default "beaglev_ahead" if BEAGLEV_AHEAD

endif
```

## scripts/boards/deepcomputing/Kconfig
```kconfig
if DEEPCOMPUTING
	config VENDOR_NAME
		string
		default "deepcomputing"

	config BOARD_NAME
		string
		default "roma" if ROMA

	config ARCH
		string
		default "riscv" if ROMA

	config TARGET_ARCH
		string
		default "riscv64" if ROMA

	config CONFIG_FILE
		string "config file name for target board"
		default "roma" if ROMA

endif
```

## scripts/boards/deepcomputing/roma/Kconfig
```kconfig
mainmenu "ROMA laptop build configuration"

source "scripts/env/Kconfig"

config BOARD_SUBFIX
	string "the subfix of sourcecode and install dir"
	default "_roma"

#using the generic Kconfig from components dir
source "scripts/components/Kconfig.linux"
source "scripts/boards/deepcomputing/roma/Kconfig.image"
```

## scripts/boards/deepcomputing/roma/Kconfig.image
```kconfig
menu "SD/flash Image build configuration"

config DEEPCOMPUTING_ROMA_ROOTFS_SIZE
	int "rootfs partition(ext4) size(1M)."
	default 8000

endmenu
```

## scripts/boards/milkv/Kconfig
```kconfig
if MILKV
	config VENDOR_NAME
		string
		default "milkv"

	config BOARD_NAME
		string
		default "milkv_pioneer" if MILKV_PIONEER
		default "milkv_duo" if MILKV_DUO

	config ARCH
		string
		default "riscv" if (MILKV_PIONEER || MILKV_DUO)

	config TARGET_ARCH
		string
		default "riscv64" if (MILKV_PIONEER || MILKV_DUO)

	config CONFIG_FILE
		string "config file name for target board"
		default "milkv_pioneer" if MILKV_PIONEER
		default "milkv_duo" if MILKV_DUO

endif
```

## scripts/boards/milkv/milkv_pioneer/Kconfig
```kconfig
mainmenu "T-HEAD TH1520 LIGHT build configuration"

config BOARD_SUBFIX
	string "the subfix of sourcecode and install dir"
	default "_th1520_light"

#using the generic Kconfig from components dir
source "scripts/components/Kconfig.linux"
source "scripts/components/Kconfig.u-boot"
source "scripts/components/Kconfig.opensbi"
#using the target specific Kconfig from boards dir
#source "scripts/boards/thead/th1520_light/Kconfig.image"
```

## scripts/boards/sipeed/Kconfig
```kconfig
if SIPEED
	config VENDOR_NAME
		string
		default "sipeed"

	config BOARD_NAME
		string
		default "lichee_pi_4a" if LICHEE_PI_4A

	config ARCH
		string
		default "riscv" if LICHEE_PI_4A

	config TARGET_ARCH
		string
		default "riscv64" if LICHEE_PI_4A

	config CONFIG_FILE
		string "config file name for target board"
		default "lichee_pi_4a" if LICHEE_PI_4A

endif
```

## scripts/boards/sipeed/lichee_pi_4a/Kconfig.image
```kconfig
menu "SD/flash Image build configuration"

config SOPHGO_SG2042_EVB_UENV_PATH
	string "Pre-build uEnv.txt file path"
	default "../../prebuild/image_sophgo_sg2042_evb/uEnv.txt"

config SOPHGO_SG2042_EVB_ROOTFS_IMAGE_PATH
	string "Pre-build rootfs image(ext) path"
	default "../../prebuild/image_sophgo_sg2042_evb/test.ext4"

config SOPHGO_SG2042_EVB_BOOT_START
	int "boot partition(vfat) start sector( 512 B/sector ) number."
	default 4096

config SOPHGO_SG2042_EVB_BOOT_SECTORS
	int "boot partition(vfat) size(in sectors)."
	default 466943

config SOPHGO_SG2042_EVB_BOOTLOADER_START
	int "bootloader partition(raw) start sector( 512 B/sector ) number."
	default 471040

config SOPHGO_SG2042_EVB_BOOTLOADER_SECTORS
	int "bootloader partition(raw) size(in sectors)."
	default 2047

config SOPHGO_SG2042_EVB_ROOTFS_START
	int "rootfs partition(ext4) start sector( 512 B/sector ) number."
	default 475136

config SOPHGO_SG2042_EVB_ROOTFS_SECTORS
	int "rootfs partition(ext4) size(in sectors)."
	default 466943

endmenu
```

## scripts/boards/sophgo/Kconfig
```kconfig
if SOPHGO
	config VENDOR_NAME
		string
		default "sophgo"

	config BOARD_NAME
		string
		default "sg2042_evb" if SG2042_EVB

	config CONFIG_FILE
		string "config file name for target board"
		default "sg2042_evb" if SG2042_EVB

endif
```

## scripts/boards/sophgo/Kconfig.zsbl
```kconfig
menu "zsbl build configuration[Sophgo]"

choice ZSBL_CROSS_COMPILE_SELECTION
	bool "Cross compiler selection"
	default WITH_DEFAULT_CROSS_COMPILE

config ZSBL_WITH_DEFAULT_CROSS_COMPILE
	bool "Corss compiler in the distro"

config ZSBL_WITH_CUSTOM_CROSS_COMPILE
	bool "custom corss compiler"

endchoice

#if ZSBL_WITH_DEFAULT_CROSS_COMPILE
#
#endif

if ZSBL_WITH_CUSTOM_CROSS_COMPILE

config ZSBL_CUSTOM_CROSS_COMPILE_DIR
	string "The custom corss compiler directory/path"
	default "/usr/bin"

config ZSBL_CUSTOM_CROSS_COMPILE
	string "The custom corss compiler prefix"
	default "riscv64-unknown-elf-"

endif

config ZSBL_REPO_PATH
	string "zsbl REPO path"
	default "src/firmware/zsbl"

choice ZSBL_GIT_REPO
	bool "Build choice"

config ZSBL_GIT_REPO_R
	bool "Build from Remote REPO"

config ZSBL_GIT_REPO_L
	bool "Build from local branch or commit"

config ZSBL_RAW_SRC
	bool "Build from the source code dir directly"

endchoice

if ZSBL_GIT_REPO_R

config ZSBL_GIT_REMOTE
	string "zsbl Remote REPO name"
	default "origin"

config ZSBL_GIT_RBRANCH
	string "The branch we will use in zsbl Remote REPO"
	default "master"

endif

if ZSBL_GIT_REPO_L

config ZSBL_GIT_LBRANCH
	string "The branch/commit we will use in local REPO"
	default "master"

endif

if ZSBL_RAW_SRC

config ZSBL_SRC_PATH
	string "The source code dir for zsbl"
	default "path/to/zsbl/src"

endif

config ZSBL_BUILD_IN_TMPFS
	bool "Build zsbl in tmpfs(in RAM)"
	default n

config ZSBL_BUILD_TARGET
	string "The target board/Chip we will build for"
	default "sg2042"

config ZSBL_BUILD_ARGS
	string "Specifies the build arguments"
	default " "

endmenu
```

## scripts/boards/sophgo/sg2042_evb/Kconfig
```kconfig
mainmenu "Sophgo SG2042 EVB build configuration"

config ARCH
	string
	default "riscv"

config TARGET_ARCH
	string
	default "riscv64"

source "scripts/env/Kconfig"

config BOARD_SUBFIX
	string "the subfix of sourcecode and install dir"
	default "_sg2042_evb"

#using the generic Kconfig from components dir
source "scripts/boards/sophgo/Kconfig.zsbl"
source "scripts/components/Kconfig.opensbi"
source "scripts/components/Kconfig.u-boot"
source "scripts/components/Kconfig.grub"
source "scripts/components/Kconfig.linux"

#using the target specific Kconfig from boards dir
source "scripts/boards/Kconfig.image"

source "scripts/boards/sophgo/sg2042_evb/Kconfig.firmware"
```

## scripts/boards/sophgo/sg2042_evb/Kconfig.firmware
```kconfig
menu "Firmware deploy configuration"

config FW_ARM_TF_FIP_PATH
	string "the path of arm-TF fip.bin [BL1+BL2]."
	default "/home/tekkamanninja/development/tekkamanv_sdk/prebuild/sophgo/sg2042_evb/firmware/fip.bin"

config FW_DTB_PATH
	string "the path of dtb for SG2042 EVB."
	default "/home/tekkamanninja/development/tekkamanv_sdk/prebuild/sophgo/sg2042_evb/firmware/*.dtb"

config FW_LINUXBOOT_DIR
	string "the directory of LinuxBoot binaries for SG2042 EVB."
	default "/home/tekkamanninja/development/tekkamanv_sdk/prebuild/sophgo/sg2042_evb/firmware/"

endmenu
```

## scripts/boards/thead/Kconfig
```kconfig
if THEAD
	config VENDOR_NAME
		string
		default "thead"

	config BOARD_NAME
		string
		default "th1520_light" if TH1520_LIGHT

	config ARCH
		string
		default "riscv" if TH1520_LIGHT

	config TARGET_ARCH
		string
		default "riscv64" if TH1520_LIGHT

	config CONFIG_FILE
		string "config file name for target board"
		default "th1520_light" if TH1520_LIGHT

endif
```

## scripts/boards/thead/th1520_light/Kconfig
```kconfig
mainmenu "T-HEAD TH1520 LIGHT build configuration"

source "scripts/env/Kconfig"

config BOARD_SUBFIX
	string "the subfix of sourcecode and install dir"
	default "_th1520_light"

#using the generic Kconfig from components dir
source "scripts/components/Kconfig.linux"
source "scripts/components/Kconfig.u-boot"
source "scripts/components/Kconfig.opensbi"
#using the target specific Kconfig from boards dir
source "scripts/boards/Kconfig.image"
```

## scripts/components/Kconfig.grub
```kconfig
menu "GRUB build configuration[Generic]"

choice GRUB_CROSS_COMPILE_SELECTION
	bool "Cross compiler selection"
	default GRUB_WITH_CUSTOM_CROSS_COMPILE

config GRUB_WITH_DEFAULT_CROSS_COMPILE
	bool "Corss compiler in the distro"

config GRUB_WITH_CUSTOM_CROSS_COMPILE
	bool "custom corss compiler"

endchoice

#if GRUB_WITH_DEFAULT_CROSS_COMPILE
#
#endif

if GRUB_WITH_CUSTOM_CROSS_COMPILE

config GRUB_CUSTOM_CROSS_COMPILE_DIR
	string "The custom corss compiler directory/path"
	default "/usr/bin"

config GRUB_CUSTOM_CROSS_COMPILE
	string "The custom corss compiler prefix"
	default "riscv64-linux-gnu-"

endif

config GRUB_REPO_PATH
	string "GRUB REPO path"
	default "src/bootloader/grub"

choice GRUB_GIT_REPO
	bool "Build choice"

config GRUB_GIT_REPO_R
	bool "Build from Remote REPO"

config GRUB_GIT_REPO_L
	bool "Build from local branch or commit"

config GRUB_RAW_SRC
	bool "Build from the source code dir directly"

endchoice

if GRUB_GIT_REPO_R

config GRUB_GIT_REMOTE
	string "GRUB Remote REPO name"
	default "origin"

config GRUB_GIT_RBRANCH
	string "The branch we will use in GRUB Remote REPO"
	default "main"

endif

if GRUB_GIT_REPO_L

config GRUB_GIT_LBRANCH
	string "The branch/commit we will use in local REPO"
	default "main"

endif


if GRUB_RAW_SRC

config GRUB_SRC_PATH
	string "The source code dir for linux kernel"
	default "path/to/linux/src"

endif

config GRUB_GNULIB_PATH
	string "The pre-download gunlib repo(for saving time in config stage)"
	default "/mnt/development/REPOs/gnulib"

config GRUB_BUILD_IN_TMPFS
	bool "Build GRUB in tmpfs(in RAM)"
	default n

config GRUB_BUILD_TARGET
	string "The target board we will build for"
	default "riscv64"

config GRUB_BUILD_CONFIG
	string "The configs we will use in build"
	default "--target=riscv64-linux-gnu --with-platform=efi" if TARGET_ARCH = "riscv64"

endmenu
```

## scripts/components/Kconfig.linux
```kconfig
menu "Linux kernel build configuration[Generic]"

config LINUX_REPO_PATH
	string "Linux kernel REPO path"
	default "src/kernel/linux"

choice LINUX_GIT_REPO
	bool "Build choice"

config LINUX_GIT_REPO_R
	bool "Build from Remote REPO"

config LINUX_GIT_REPO_L
	bool "Build from local branch or commit"

config LINUX_RAW_SRC
	bool "Build from the source code dir directly"

endchoice

if LINUX_GIT_REPO_R

config LINUX_GIT_REMOTE
	string "Linux Remote REPO name"
	default "origin"

config LINUX_GIT_RBRANCH
	string "The branch we will use in Linux Remote REPO"
	default "main"

endif

if LINUX_GIT_REPO_L

config LINUX_GIT_LBRANCH
	string "The branch/commit we will use in local REPO"
	default "origin"

endif

if LINUX_RAW_SRC

config LINUX_SRC_PATH
	string "The source code dir for linux kernel"
	default "path/to/linux/src"

endif

config LINUX_BUILD_IN_TMPFS
	bool "Build Linux kernel in tmpfs(in RAM)"
	default n

config LINUX_BUILD_TARGET
	string "Linux kernel defconfig name"
	default "riscv64"

config LINUX_INSTALL_SUDO
	bool "Install Linux with sudo"
	default n

endmenu
```

## scripts/components/Kconfig.opensbi
```kconfig
menu "OpenSBI build configuration[Generic]"

config OPENSBI_REPO_PATH
	string "OpenSBI REPO path"
	default "src/firmware/opensbi"

choice OPENSBI_GIT_REPO
	bool "Build choice"

config OPENSBI_GIT_REPO_R
	bool "Build from Remote REPO"

config OPENSBI_GIT_REPO_L
	bool "Build from local branch or commit"

config OPENSBI_RAW_SRC
	bool "Build from the source code dir directly"

endchoice

if OPENSBI_GIT_REPO_R

config OPENSBI_GIT_REMOTE
	string "OpenSBI Remote REPO name"
	default "origin"

config OPENSBI_GIT_RBRANCH
	string "The branch we will use in OpenSBI Remote REPO"
	default "master"

endif

if OPENSBI_GIT_REPO_L

config OPENSBI_GIT_LBRANCH
	string "The branch/commit we will use in local REPO"
	default "master"

endif

if OPENSBI_RAW_SRC

config OPENSBI_SRC_PATH
	string "The source code dir for OpenSBI"
	default "path/to/opensbi/src"

endif

choice OPENSBI_PLATFORM
	bool "platform choice"
	default OPENSBI_PLATFORM_GENERIC

config OPENSBI_PLATFORM_GENERIC
	bool "Build generic platform"

config OPENSBI_PLATFORM_SOC
	bool "Build platform/vendor/<board|soc>"

endchoice

config OPENSBI_BUILD_IN_TMPFS
	bool "Build OpenSBI in tmpfs(in RAM)"
	default n

config OPENSBI_BUILD_PLATFORM
	string "Specifies the platform which will be built"
	default "sophgo/sg2042" if OPENSBI_PLATFORM_SOC
	default "generic" if OPENSBI_PLATFORM_GENERIC

config OPENSBI_BUILD_TARGET
	string "The target board/Chip we will build for"
	default "th1520"

config OPENSBI_BUILD_ARGS
	string "Specifies the build arguments"
	default "BUILD_INFO=y"

config OPENSBI_PREBUILD_UBOOT_BIN
	string "Pre-build U-boot Bin path"
	default "../../../output/firmware/u-boot_sophgo_sg2042_evb/u-boot.bin"

config OPENSBI_PREBUILD_DTB
	string "Pre-build dtb path"
	default "../../../output/firmware/u-boot_sophgo_sg2042_evb/u-boot.dtb"

endmenu
```

## scripts/components/Kconfig.u-boot
```kconfig
menu "U-boot build configuration[Generic]"

config UBOOT_REPO_PATH
	string "U-Boot REPO path"
	default "src/bootloader/u-boot"

choice UBOOT_GIT_REPO
	bool "Build choice"

config UBOOT_GIT_REPO_R
	bool "Build from Remote REPO"

config UBOOT_GIT_REPO_L
	bool "Build from local branch or commit"

endchoice

if UBOOT_GIT_REPO_R

config UBOOT_GIT_REMOTE
	string "U-Boot Remote REPO name"
	default "origin"

config UBOOT_GIT_RBRANCH
	string "The branch we will use in U-Boot Remote REPO"
	default "main"

endif

if UBOOT_GIT_REPO_L

config UBOOT_GIT_LBRANCH
	string "The branch/commit we will use in local REPO"
	default "main"

endif

config UBOOT_BUILD_IN_TMPFS
	bool "Build U-Boot in tmpfs(in RAM)"
	default n

config UBOOT_BUILD_TARGET
	string "The target board we will build for"
	default "riscv64"

endmenu
```
